#include <Wire.h>
#include <Adafruit_GFX.h>
#include <Adafruit_SSD1306.h>
#include <Adafruit_ADS1X15.h>
#include <Adafruit_INA219.h>
#include <OneWire.h>
#include <DallasTemperature.h>
#include <math.h>
// Include ML model headers generated by m2cgen
#include "models/model_weights.h"
#include "models/rul_model.h"

// ============================================================
// BATTERY GUARDIAN - 3S Li-ion Monitoring + ML-Ready Features
// Corrected version:
// - Voltage measurement restored to ADS1115 (A0/A1/A2)
// - INA219: CURRENT + POWER only (NO BUS VOLTAGE)
// - 3 x DS18B20 temperature sensors
// - Critical safety timer with shorter OLED countdown
// - Status LEDs + relay + active buzzer on GPIO26
// ============================================================

// -------------------- Hardware Pin Definitions --------------------
#define I2C_SDA      21
#define I2C_SCL      22
#define ONE_WIRE_BUS 4

// -------------------- Status LEDs --------------------
// Connect LED anodes through suitable resistors (220-330 ohm)
// to these GPIOs, and LED cathodes to GND.
#define GREEN_LED_PIN  18
#define YELLOW_LED_PIN 19
#define RED_LED_PIN    25

// Relay control
#define RELAY_PIN      27
#define BUZZER_PIN     26
// THIS RELAY MODULE IS ACTIVE-HIGH:
// GPIO27 HIGH = relay ON / energized / click
// GPIO27 LOW  = relay OFF / de-energized / click
const bool RELAY_ACTIVE_LOW = false;

// Required safety behavior:
// NORMAL  -> relay ON
// WARNING -> relay ON
// CRITICAL -> relay OFF immediately

// Blink timing
const unsigned long WARNING_RED_BLINK_MS  = 500;
const unsigned long CRITICAL_RED_BLINK_MS = 150;

// Buzzer pattern
const unsigned long WARNING_BUZZ_ON_MS  = 250;
const unsigned long WARNING_BUZZ_OFF_MS = 750;
const unsigned long CRITICAL_BUZZ_ON_MS  = 120;
const unsigned long CRITICAL_BUZZ_OFF_MS = 120;

// -------------------- OLED --------------------
#define SCREEN_WIDTH  128
#define SCREEN_HEIGHT 64
#define OLED_RESET    -1

Adafruit_SSD1306 display(SCREEN_WIDTH, SCREEN_HEIGHT, &Wire, OLED_RESET);

// -------------------- Sensors --------------------
Adafruit_ADS1115 ads;
Adafruit_INA219  ina219;
OneWire oneWire(ONE_WIRE_BUS);
DallasTemperature tempSensor(&oneWire);

// -------------------- I2C Addresses --------------------
#define OLED_ADDRESS 0x3C
#define ADS_ADDRESS  0x48
#define INA_ADDRESS  0x40

// ============================================================
// VOLTAGE DIVIDER CALIBRATION
// Hardware: 100k TOP + 33k BOTTOM
// Node -> 100k -> ADC junction -> 33k -> Pack-/GND
//
// These calibrated factors are retained from the previous
// working Battery_Guardian.ino because that version produced
// the correct multimeter-matched cell voltages.
// ============================================================
const float DIVIDER_RATIO_1 = 4.0309;
const float DIVIDER_RATIO_2 = 4.0304;
const float DIVIDER_RATIO_3 = 4.0308;

// -------------------- Safety Thresholds: v1.2 --------------------
// Cell voltage
const float CELL_NORMAL_MIN = 3.30;
const float CELL_NORMAL_MAX = 4.15;
const float CELL_WARN_LOW   = 3.00;
const float CELL_WARN_HIGH  = 4.16;
const float CELL_CRIT_MIN   = 3.00;
const float CELL_CRIT_MAX   = 4.25;

// Cell imbalance
const float IMBALANCE_CRIT = 0.10;   // 100 mV

// 3S pack voltage
const float PACK_NORMAL_MIN = 9.90;
const float PACK_NORMAL_MAX = 12.45;
const float PACK_WARN_LOW   = 9.00;
const float PACK_WARN_HIGH  = 12.46;
const float PACK_CRIT_MIN   = 9.00;
const float PACK_CRIT_MAX   = 12.75;

// Current
const float CURRENT_NORMAL_MAX = 2.00;
const float CURRENT_WARN_MAX   = 3.499;
const float CURRENT_CRIT_MAX   = 3.50;

// Temperature
const float TEMP_NORMAL_MAX = 40.0;
const float TEMP_WARN_MAX   = 47.9;
const float TEMP_CRIT_MAX   = 48.0;

// -------------------- Timing --------------------
const unsigned long SENSOR_INTERVAL = 1000;
const unsigned long PAGE_INTERVAL   = 10000;

unsigned long lastSensorReadTime = 0;
unsigned long lastPageSwapTime   = 0;
bool showStatusPage = false;

// -------------------- Critical Safety Timer --------------------
// Timer starts ONLY when the state ENTERS CRITICAL.
// WARNING has NO countdown.
// OLED shows a shorter driver-facing countdown than the actual relay cutoff.
// Severity mapping:
// Mild:     OLED 45 s, relay OFF after 90 s
// Moderate: OLED 30 s, relay OFF after 60 s
// Severe:   OLED 15 s, relay OFF after 30 s
// When OLED countdown reaches 0, relay stays ON until actual cutoff.
// Prototype human-factors concept; validate before real road use.
bool criticalTimerActive = false;
bool criticalRelayCutoff = false;
unsigned long criticalStartMillis = 0;
unsigned long criticalActualDurationMillis = 30000UL;
unsigned long criticalDisplayedDurationMillis = 15000UL;
int criticalSeverity = 1;

// LED blink state
bool redLedState = false;
unsigned long lastRedBlinkMillis = 0;

bool buzzerState = false;
unsigned long lastBuzzerMillis = 0;

// -------------------- ML Inference Variables --------------------
float predictedSoH = 100.0;
float predictedRUL = 800.0;

// Scaler means and scales extracted from training dataset
const float FEATURE_MEANS[23] = {
  10120.5956, 12.5508, 9.2475, 9.0957, 12.5508, 10.8992, 3.3033, 0.0003, 
  1.0064, 0.0035, 0.7303, 0.5803, 0.9292, 22.5084, 31.9939, 22.5084, 
  32.2365, 27.2499, 9.7290, 0.0010, 0.9845, 0.1049, 31.9797
};

const float FEATURE_SCALES[23] = {
  1700.9816, 0.0292, 0.1445, 0.1497, 0.0292, 0.0751, 0.1445, 0.0001, 
  0.1137, 0.2799, 0.0497, 0.0563, 0.0756, 0.4851, 3.5617, 0.4851, 
  3.5694, 1.8335, 3.5285, 0.0005, 0.2857, 0.0347, 4.6554
};

// -------------------- Sensor Variables --------------------
float vNode1 = 0.0;
float vNode2 = 0.0;
float vNode3 = 0.0;

float vCell1 = 0.0;
float vCell2 = 0.0;
float vCell3 = 0.0;
float packVoltage = 0.0;

float currentA = 0.0;
float powerW = 0.0;

float t1 = 0.0;
float t2 = 0.0;
float t3 = 0.0;

float minCell = 0.0;
float maxCell = 0.0;
float avgCell = 0.0;
float cellImbalance = 0.0;

float maxTemp = 0.0;
float avgTemp = 0.0;
float tempDifference = 0.0;

// -------------------- ML-Ready Time Features --------------------
float previousPackVoltage = 0.0;
float previousMaxTemp = 0.0;
float previousCurrentA = 0.0;

float dVdt = 0.0;
float dTdt = 0.0;
float dIdt = 0.0;

unsigned long previousFeatureTime = 0;

// -------------------- Simple Internal Resistance Estimate --------------------
float vOpenCircuit = 0.0;
float rInt_mOhm = 0.0;

// -------------------- Status Reason --------------------
String warningReason = "";
String criticalReason = "";

// -------------------- System State --------------------
enum SystemState {
  STATE_NORMAL,
  STATE_WARNING,
  STATE_CRITICAL
};

SystemState currentState = STATE_NORMAL;
SystemState previousState = STATE_NORMAL;
bool criticalLatched = false;

// -------------------- ML Inference Variables --------------------
float predictedSoH = 100.0;
float predictedRUL = 800.0;

// Scaler means and scales from Python StandardScaler training output
const float FEATURE_MEANS[23] = {
  // Paste your feature_means array values here
};
const float FEATURE_SCALES[23] = {
  // Paste your feature_scales array values here
};


// ============================================================
// Read voltage using ADS1115 and calibrated divider
// ============================================================
float readNodeVoltage(uint8_t channel, float dividerRatio) {
  // Average multiple ADS1115 samples to reduce I2C/ADC noise.
  // The divider calibration factors are the proven multimeter-matched
  // values from the previous working Battery Guardian setup.
  const uint8_t SAMPLES = 8;
  long rawSum = 0;

  for (uint8_t i = 0; i < SAMPLES; i++) {
    rawSum += ads.readADC_SingleEnded(channel);
    delayMicroseconds(200);
  }

  int16_t rawAverage = (int16_t)(rawSum / SAMPLES);
  float adcVoltage = ads.computeVolts(rawAverage);

  if (adcVoltage < 0.0f) {
    adcVoltage = 0.0f;
  }

  return adcVoltage * dividerRatio;
}

// ============================================================
// CRITICAL TIMING
// ============================================================
int getCriticalSeverity() {
  int severity = 1;

  // These severity bands are intentionally stricter than the critical
  // thresholds: crossing critical enters CRITICAL; how far beyond the
  // threshold determines the response time.
  if (maxTemp >= 55.0) severity = max(severity, 3);
  else if (maxTemp >= 51.0) severity = max(severity, 2);

  if (minCell < 2.80 || maxCell > 4.35) severity = max(severity, 3);
  else if (minCell < 2.90 || maxCell > 4.30) severity = max(severity, 2);

  if (cellImbalance >= 0.20) severity = max(severity, 3);
  else if (cellImbalance >= 0.15) severity = max(severity, 2);

  if (currentA >= 5.0) severity = max(severity, 3);
  else if (currentA >= 4.0) severity = max(severity, 2);

  if (packVoltage < 8.70 || packVoltage > 13.00) severity = max(severity, 3);
  else if (packVoltage < 8.90 || packVoltage > 12.90) severity = max(severity, 2);

  return severity;
}

void calculateCriticalTimes() {
  criticalSeverity = getCriticalSeverity();

  if (criticalSeverity >= 3) {
    criticalActualDurationMillis = 30000UL;
    criticalDisplayedDurationMillis = 15000UL;
  } else if (criticalSeverity == 2) {
    criticalActualDurationMillis = 60000UL;
    criticalDisplayedDurationMillis = 30000UL;
  } else {
    criticalActualDurationMillis = 90000UL;
    criticalDisplayedDurationMillis = 45000UL;
  }
}

int getCriticalDisplayedSecondsRemaining() {
  if (!criticalTimerActive) return 0;
  unsigned long elapsed = millis() - criticalStartMillis;
  if (elapsed >= criticalDisplayedDurationMillis) return 0;
  return (int)((criticalDisplayedDurationMillis - elapsed + 999UL) / 1000UL);
}

int getCriticalActualSecondsRemaining() {
  if (!criticalTimerActive) return 0;
  unsigned long elapsed = millis() - criticalStartMillis;
  if (elapsed >= criticalActualDurationMillis) return 0;
  return (int)((criticalActualDurationMillis - elapsed + 999UL) / 1000UL);
}

bool criticalIsolationExpired() {
  return criticalTimerActive &&
         ((millis() - criticalStartMillis) >= criticalActualDurationMillis);
}

void startCriticalTimer() {
  calculateCriticalTimes();
  criticalStartMillis = millis();
  criticalTimerActive = true;
  criticalRelayCutoff = false;
}

// ============================================================
// Evaluate NORMAL / WARNING / CRITICAL
// ============================================================
SystemState evaluateState() {
  warningReason = "";

  // Keep the original critical reason after the critical latch is set.
  if (criticalLatched) {
    return STATE_CRITICAL;
  }

  criticalReason = "";

  // -------- CRITICAL: highest priority --------
  if (maxTemp >= TEMP_CRIT_MAX) {
    criticalReason = "OVER TEMP";
    criticalLatched = true;
    return STATE_CRITICAL;
  }

  if (minCell < CELL_CRIT_MIN) {
    criticalReason = "CELL UNDER V";
    criticalLatched = true;
    return STATE_CRITICAL;
  }

  if (maxCell > CELL_CRIT_MAX) {
    criticalReason = "CELL OVER V";
    criticalLatched = true;
    return STATE_CRITICAL;
  }

  if (cellImbalance > IMBALANCE_CRIT) {
    criticalReason = "CELL IMBALANCE";
    criticalLatched = true;
    return STATE_CRITICAL;
  }

  if (currentA >= CURRENT_CRIT_MAX) {
    criticalReason = "OVER CURRENT";
    criticalLatched = true;
    return STATE_CRITICAL;
  }

  if (packVoltage < PACK_CRIT_MIN) {
    criticalReason = "PACK UNDER V";
    criticalLatched = true;
    return STATE_CRITICAL;
  }

  if (packVoltage > PACK_CRIT_MAX) {
    criticalReason = "PACK OVER V";
    criticalLatched = true;
    return STATE_CRITICAL;
  }

  // -------- WARNING --------
  if (maxTemp >= TEMP_NORMAL_MAX && maxTemp < TEMP_CRIT_MAX) {
    warningReason = "TEMP RISING";
    return STATE_WARNING;
  }

  if (minCell < CELL_NORMAL_MIN && minCell >= CELL_CRIT_MIN) {
    warningReason = "LOW CELL V";
    return STATE_WARNING;
  }

  if (maxCell > CELL_NORMAL_MAX && maxCell <= CELL_CRIT_MAX) {
    warningReason = "HIGH CELL V";
    return STATE_WARNING;
  }

  if (cellImbalance > IMBALANCE_CRIT) {
    warningReason = "CELL IMBALANCE";
    return STATE_WARNING;
  }

  if (currentA >= CURRENT_NORMAL_MAX && currentA < CURRENT_CRIT_MAX) {
    warningReason = "HIGH CURRENT";
    return STATE_WARNING;
  }

  if ((packVoltage >= PACK_WARN_LOW && packVoltage < PACK_NORMAL_MIN) ||
      (packVoltage > PACK_NORMAL_MAX && packVoltage <= PACK_WARN_HIGH)) {
    warningReason = "PACK VOLTAGE";
    return STATE_WARNING;
  }

  return STATE_NORMAL;
}

// ============================================================
// Start / update warning timer
// ============================================================
void updateCriticalTimer(SystemState newState) {
  // WARNING and NORMAL never run the critical timer.
  if (newState != STATE_CRITICAL) {
    criticalTimerActive = false;
    criticalRelayCutoff = false;
    previousState = newState;
    return;
  }

  // Start exactly once, on the transition into CRITICAL.
  if (previousState != STATE_CRITICAL && !criticalTimerActive) {
    startCriticalTimer();
  }

  // The displayed countdown and actual cutoff are independent.
  // Displayed time may reach 0 while relay remains ON.
  if (criticalTimerActive && criticalIsolationExpired()) {
    criticalRelayCutoff = true;
  }

  previousState = newState;
}

// ============================================================
// Update ML time features
// ============================================================
void updateTimeFeatures() {
  unsigned long now = millis();

  if (previousFeatureTime == 0) {
    previousFeatureTime = now;
    previousPackVoltage = packVoltage;
    previousMaxTemp = maxTemp;
    previousCurrentA = currentA;
    dVdt = 0.0;
    dTdt = 0.0;
    dIdt = 0.0;
    return;
  }

  float dt = (now - previousFeatureTime) / 1000.0;

  if (dt > 0.0) {
    dVdt = (packVoltage - previousPackVoltage) / dt;
    dTdt = (maxTemp - previousMaxTemp) / dt;
    dIdt = (currentA - previousCurrentA) / dt;
  }

  previousFeatureTime = now;
  previousPackVoltage = packVoltage;
  previousMaxTemp = maxTemp;
  previousCurrentA = currentA;
}

// ============================================================
// Internal resistance estimate
// Note: useful as a prototype feature, not a lab-grade test.
// ============================================================
void updateInternalResistance() {
  if (currentA < 0.03) {
    vOpenCircuit = packVoltage;
    rInt_mOhm = 0.0;
    return;
  }

  float vDrop = vOpenCircuit - packVoltage;

  if (currentA > 0.10 && vDrop > 0.01) {
    rInt_mOhm = (vDrop / currentA) * 1000.0;
  } else {
    rInt_mOhm = 0.0;
  }
}

// ============================================================
// Serial output
// ============================================================
void printSerial() {
  Serial.println();
  Serial.println(F("===================================================="));
  Serial.println(F("                 BATTERY GUARDIAN"));
  Serial.println(F("===================================================="));

  Serial.println(F("------ CELL VOLTAGES ------"));
  Serial.printf("Cell 1: %.3f V\n", vCell1);
  Serial.printf("Cell 2: %.3f V\n", vCell2);
  Serial.printf("Cell 3: %.3f V\n", vCell3);
  Serial.printf("Pack  : %.3f V\n", packVoltage);
  Serial.printf("Imbalance: %.1f mV\n", cellImbalance * 1000.0);

  Serial.println(F("------ INA219 ------"));
  Serial.printf("Current: %.3f A\n", currentA);
  Serial.printf("Power  : %.3f W\n", powerW);

  Serial.println(F("------ TEMPERATURE ------"));
  Serial.printf("T1: %.2f C\n", t1);
  Serial.printf("T2: %.2f C\n", t2);
  Serial.printf("T3: %.2f C\n", t3);
  Serial.printf("Max Temp: %.2f C\n", maxTemp);
  Serial.printf("Temp Difference: %.2f C\n", tempDifference);

  Serial.println(F("------ ML FEATURES ------"));
  Serial.printf("Vmin: %.3f V\n", minCell);
  Serial.printf("Vmax: %.3f V\n", maxCell);
  Serial.printf("Vavg: %.3f V\n", avgCell);
  Serial.printf("Tavg: %.2f C\n", avgTemp);
  Serial.printf("dV/dt: %.5f V/s\n", dVdt);
  Serial.printf("dT/dt: %.5f C/s\n", dTdt);
  Serial.printf("dI/dt: %.5f A/s\n", dIdt);
  Serial.printf("Rint: %.2f mOhm\n", rInt_mOhm);

  if (currentState == STATE_CRITICAL) {
    Serial.printf("STATE: CRITICAL - %s\n", criticalReason.c_str());
    Serial.printf("CRITICAL SEVERITY: %d\n", criticalSeverity);
    if (criticalRelayCutoff || criticalIsolationExpired()) {
      Serial.println(F("RELAY: OFF - LOAD ISOLATED"));
      Serial.println(F("Current: 0.000 A | Power: 0.000 W"));
    } else {
      Serial.printf("OLED SAFE TIME REMAINING: %d s\n", getCriticalDisplayedSecondsRemaining());
      Serial.printf("ACTUAL RELAY CUTOFF REMAINING: %d s\n", getCriticalActualSecondsRemaining());
      Serial.println(F("RELAY: ON DURING CRITICAL SAFETY COUNTDOWN"));
    }
  } else if (currentState == STATE_WARNING) {
    Serial.printf("STATE: WARNING - %s\n", warningReason.c_str());
    Serial.println(F("RELAY: ON - NO CRITICAL TIMER"));
  } else {
    Serial.println(F("STATE: NORMAL"));
  }

  Serial.println(F("===================================================="));
}

// ============================================================
// OLED NORMAL
// ============================================================
void displayNormal() {
  display.clearDisplay();
  display.setTextSize(1);
  display.setCursor(18, 0);
  display.print(F("BATTERY GUARDIAN"));

  display.setCursor(0, 12);
  display.printf("C1:%.2fV C2:%.2fV", vCell1, vCell2);

  display.setCursor(0, 22);
  display.printf("C3:%.2fV Pk:%.2fV", vCell3, packVoltage);

  display.setCursor(0, 32);
  display.printf("I:%.2fA P:%.2fW", currentA, powerW);

  display.setCursor(0, 42);
  display.printf("T:%.1fC dV:%.0fmV", maxTemp, cellImbalance * 1000.0);

  display.setCursor(0, 32);
  display.printf("SoH:%.1f%% RUL:%d", predictedSoH, (int)predictedRUL);

  display.setCursor(0, 42);
  display.printf("T:%.1fC IR:%.1fmO", maxTemp, rInt_mOhm);
  display.setCursor(0, 54);
  display.print(F("STATE: NORMAL"));

  display.display();
}

// ============================================================
// OLED WARNING
// ============================================================
void displayWarning() {
  display.clearDisplay();
  display.setTextSize(1);
  display.setCursor(25, 0);
  display.print(F("!! WARNING !!"));

  display.setCursor(0, 14);
  display.print(warningReason);

  display.setTextSize(2);
  display.setCursor(15, 28);
  display.print(F("RELAY ON"));

  display.setTextSize(1);
  display.setCursor(0, 50);
  display.print(F("MOVE TO SAFE AREA"));

  display.setCursor(0, 60);
  display.print(F("Battery still powered"));

  display.display();
}

// ============================================================
// OLED CRITICAL
// ============================================================
void displayCritical() {
  display.clearDisplay();

  display.setTextSize(1);
  display.setCursor(26, 0);
  display.print(F("!! CRITICAL !!"));

  display.setTextSize(2);
  display.setCursor(13, 15);
  display.print(F("DANGER"));

  display.setTextSize(1);
  display.setCursor(0, 36);
  display.print(criticalReason);

  if (criticalRelayCutoff || criticalIsolationExpired()) {
    display.setCursor(0, 46);
    display.print(F("POWER OFF  I:0.00A"));
    display.setCursor(0, 56);
    display.print(F("RELAY OFF  P:0.00W"));
  } else {
    display.setCursor(0, 46);
    // This countdown is intentionally shorter than the actual cutoff.
    // At 00s the relay is STILL ON until actual cutoff expires.
    display.printf("SAFE TIME: %02ds", getCriticalDisplayedSecondsRemaining());
    display.setCursor(0, 56);
    display.printf("RELAY ON  I:%.2fA", currentA);
  }

  display.display();
}

// ============================================================
// OLED STATUS PAGE
// ============================================================
void displayStatusPage() {
  display.clearDisplay();
  display.setTextSize(1);
  display.setCursor(16, 0);
  display.print(F("-- SYSTEM STATUS --"));

  if (currentState == STATE_CRITICAL) {
    display.setTextSize(2);
    display.setCursor(12, 16);
    display.print(F("CRITICAL"));

    display.setTextSize(1);
    display.setCursor(5, 37);
    display.print(criticalReason);

    display.setCursor(0, 48);
    if (criticalRelayCutoff || criticalIsolationExpired()) {
      display.print(F("POWER OFF I:0.00A"));
    } else {
      display.printf("SAFE:%02ds ACT:%02ds", getCriticalDisplayedSecondsRemaining(), getCriticalActualSecondsRemaining());
    }

    display.setCursor(0, 59);
    display.print((criticalRelayCutoff || criticalIsolationExpired()) ? F("RELAY OFF P:0.00W") : F("RELAY ON"));

  } else if (currentState == STATE_WARNING) {
    display.setTextSize(2);
    display.setCursor(15, 15);
    display.print(F("WARNING"));

    display.setTextSize(1);
    display.setCursor(0, 37);
    display.print(warningReason);

    display.setCursor(0, 51);
    display.print(F("RELAY ON - POWER ON"));

  } else {
    display.setTextSize(2);
    display.setCursor(28, 16);
    display.print(F("NORMAL"));

    display.setTextSize(1);
    display.setCursor(22, 37);
    display.print(F("All Systems OK"));

    display.setCursor(0, 52);
    display.printf("Pack:%.2fV T:%.1fC", packVoltage, maxTemp);
  }

  display.display();
}

// ============================================================
// RELAY CONTROL
//
// NORMAL  -> Relay ON  (battery/load path allowed)
// WARNING -> Relay ON  (system continues; warning is advisory)
// CRITICAL -> Relay OFF IMMEDIATELY (load isolation)
//
// For this user's active-HIGH relay module:
//   HIGH = relay ON
//   LOW  = relay OFF
// ============================================================
void setRelay(bool on) {
  bool outputLevel;

  if (RELAY_ACTIVE_LOW) {
    outputLevel = on ? LOW : HIGH;
  } else {
    outputLevel = on ? HIGH : LOW;
  }

  digitalWrite(RELAY_PIN, outputLevel);
}

// ============================================================
// BUZZER CONTROL
//
// GPIO26 is used for the buzzer.
//
// WARNING  -> short beep, pause, repeat
// CRITICAL -> fast beep, pause, repeat
// NORMAL   -> OFF
//
// tone() is used so this also works with a passive piezo buzzer.
// For an active buzzer, the alternating HIGH/LOW pattern also
// produces an audible alarm.
// ============================================================
void startBuzzerTone(unsigned int frequency) {
  // GPIO26 drives the active buzzer directly.
  // The frequency argument is retained so the rest of the program
  // can call the same function for warning/critical alarms.
  (void)frequency;
  digitalWrite(BUZZER_PIN, HIGH);
}

void stopBuzzerTone() {
  digitalWrite(BUZZER_PIN, LOW);
}

void updateBuzzer() {
  unsigned long now = millis();

  // After the ACTUAL critical cutoff, buzzer must remain OFF.
  if (criticalRelayCutoff) {
    stopBuzzerTone();
    buzzerState = false;
    return;
  }

  if (currentState == STATE_NORMAL) {
    stopBuzzerTone();
    buzzerState = false;
    lastBuzzerMillis = now;
  }
  else if (currentState == STATE_WARNING) {
    // Active buzzer: 250 ms ON / 750 ms OFF
    unsigned long interval = buzzerState
        ? WARNING_BUZZ_ON_MS
        : WARNING_BUZZ_OFF_MS;

    if (now - lastBuzzerMillis >= interval) {
      lastBuzzerMillis = now;
      buzzerState = !buzzerState;

      if (buzzerState) {
        startBuzzerTone(1);
      } else {
        stopBuzzerTone();
      }
    }
  }
  else {  // STATE_CRITICAL
    // Active buzzer: 120 ms ON / 120 ms OFF
    unsigned long interval = buzzerState
        ? CRITICAL_BUZZ_ON_MS
        : CRITICAL_BUZZ_OFF_MS;

    if (now - lastBuzzerMillis >= interval) {
      lastBuzzerMillis = now;
      buzzerState = !buzzerState;

      if (buzzerState) {
        startBuzzerTone(1);
      } else {
        stopBuzzerTone();
      }
    }
  }
}

// ============================================================
// STATUS LED CONTROL
//
// NORMAL:
//   Green ON, Yellow OFF, Red OFF
//
// WARNING:
//   Green OFF, Yellow ON, Red BLINKS
//
// CRITICAL:
//   Green OFF, Yellow OFF, Red BLINKS FAST
//
// This function is called continuously from loop(), so the
// LEDs can blink without blocking sensor measurements.
// ============================================================
void updateStatusLEDs() {
  unsigned long now = millis();

  if (currentState == STATE_NORMAL) {
    digitalWrite(GREEN_LED_PIN, HIGH);
    digitalWrite(YELLOW_LED_PIN, LOW);
    digitalWrite(RED_LED_PIN, LOW);
    setRelay(true);
    redLedState = false;
    lastRedBlinkMillis = now;
  }
  else if (currentState == STATE_WARNING) {
    digitalWrite(GREEN_LED_PIN, LOW);
    digitalWrite(YELLOW_LED_PIN, HIGH);
    setRelay(true);
    if (now - lastRedBlinkMillis >= WARNING_RED_BLINK_MS) {
      lastRedBlinkMillis = now;
      redLedState = !redLedState;
      digitalWrite(RED_LED_PIN, redLedState ? HIGH : LOW);
    }
  }
  else {
    // FINAL critical cutoff:
    // relay OFF + buzzer OFF + ALL LEDs OFF.
    if (criticalRelayCutoff) {
      setRelay(false);
      digitalWrite(GREEN_LED_PIN, LOW);
      digitalWrite(YELLOW_LED_PIN, LOW);
      digitalWrite(RED_LED_PIN, LOW);
      stopBuzzerTone();
      buzzerState = false;
      return;
    }

    digitalWrite(GREEN_LED_PIN, LOW);
    digitalWrite(YELLOW_LED_PIN, LOW);

    // OLED safe-time reaching 0 does NOT cut the relay.
    // Relay remains ON until the longer ACTUAL critical timer expires.
    if (criticalTimerActive && !criticalIsolationExpired()) {
      setRelay(true);
    } else {
      criticalRelayCutoff = true;
      setRelay(false);
      digitalWrite(GREEN_LED_PIN, LOW);
      digitalWrite(YELLOW_LED_PIN, LOW);
      digitalWrite(RED_LED_PIN, LOW);
      stopBuzzerTone();
      buzzerState = false;
      return;
    }

    if (now - lastRedBlinkMillis >= CRITICAL_RED_BLINK_MS) {
      lastRedBlinkMillis = now;
      redLedState = !redLedState;
      digitalWrite(RED_LED_PIN, redLedState ? HIGH : LOW);
    }
  }
}

// ============================================================
// Setup
// ============================================================
void setup() {
  pinMode(BUZZER_PIN, OUTPUT);
  digitalWrite(BUZZER_PIN, LOW);
  // Active buzzer on GPIO26: simple digital ON/OFF control.
Serial.begin(115200);
  delay(1000);

  Serial.println();
  Serial.println(F("=============================================="));
  Serial.println(F("       BATTERY GUARDIAN STARTING"));
  Serial.println(F("=============================================="));

  // Status LED pins
  pinMode(GREEN_LED_PIN, OUTPUT);
  pinMode(YELLOW_LED_PIN, OUTPUT);
  pinMode(RED_LED_PIN, OUTPUT);
  pinMode(RELAY_PIN, OUTPUT);

  // Safe startup:
  // LEDs OFF and relay OFF until the first sensor evaluation.
  // After evaluation: NORMAL/WARNING -> ON, CRITICAL -> OFF.
  digitalWrite(GREEN_LED_PIN, LOW);
  digitalWrite(YELLOW_LED_PIN, LOW);
  digitalWrite(RED_LED_PIN, LOW);
  stopBuzzerTone();
  setRelay(false);
  criticalLatched = false;
  criticalTimerActive = false;
  criticalRelayCutoff = false;

  Wire.begin(I2C_SDA, I2C_SCL);

  // OLED
  if (!display.begin(SSD1306_SWITCHCAPVCC, OLED_ADDRESS)) {
    Serial.println(F("ERROR: OLED initialization failed."));
    while (true) delay(100);
  }
  display.clearDisplay();
  display.setTextColor(SSD1306_WHITE);
  display.setTextSize(1);
  display.setCursor(16, 20);
  display.println(F("BATTERY GUARDIAN"));
  display.setCursor(12, 35);
  display.println(F("Initializing..."));
  display.display();

  // ADS1115 - IMPORTANT: voltage dividers are connected here
  if (!ads.begin(ADS_ADDRESS)) {
    Serial.println(F("ERROR: ADS1115 not detected."));
    while (true) delay(100);
  }

  // Gain ONE = +/-4.096 V.
  // With 3S pack and 100k/33k divider, ADC input remains below 4.096 V.
  ads.setGain(GAIN_ONE);

  Serial.println(F("SUCCESS: ADS1115 detected at 0x48."));

  // INA219
  if (!ina219.begin()) {
    Serial.println(F("ERROR: INA219 not detected."));
    while (true) delay(100);
  }

  // Keep the same calibration used by the previous working setup.
  ina219.setCalibration_32V_2A();

  Serial.println(F("SUCCESS: INA219 detected at 0x40."));
  Serial.println(F("INA219 output: CURRENT + POWER only."));
  Serial.println(F("Bus voltage intentionally NOT used/displayed."));
  Serial.println(F("Relay: ACTIVE-HIGH, GPIO27 HIGH = ON."));
  Serial.println(F("Buzzer: GPIO26, tone alarm enabled."));

  // DS18B20
  tempSensor.begin();
  int sensorCount = tempSensor.getDeviceCount();

  Serial.printf("DS18B20 sensors found: %d\n", sensorCount);

  if (sensorCount < 3) {
    Serial.println(F("WARNING: Less than 3 DS18B20 sensors detected."));
  }

  delay(1500);
}

void runMachineLearningInference() {
  double raw_features[23];
  raw_features[0] = 12000.0;                   // DURATION_S (estimated discharge cycle duration)
  raw_features[1] = vNode3;                    // V_START
  raw_features[2] = packVoltage;               // V_END
  raw_features[3] = minCell;                   // V_MIN
  raw_features[4] = maxCell;                   // V_MAX
  raw_features[5] = avgCell;                   // V_MEAN
  raw_features[6] = (raw_features[1] - packVoltage); // V_DROP
  raw_features[7] = dVdt;                      // VOLTAGE_SLOPE
  raw_features[8] = 1.0;                       // V_STD
  raw_features[9] = 0.0;                       // V_SKEW
  raw_features[10] = currentA;                 // I_MEAN
  raw_features[11] = currentA;                 // I_MIN
  raw_features[12] = currentA;                 // I_MAX
  raw_features[13] = t1;                       // T_START
  raw_features[14] = maxTemp;                  // T_END
  raw_features[15] = t1;                       // T_MIN
  raw_features[16] = maxTemp;                  // T_MAX
  raw_features[17] = avgTemp;                  // T_MEAN
  raw_features[18] = (maxTemp - t1);           // TEMP_RISE
  raw_features[19] = dTdt;                     // TEMP_RISE_RATE
  raw_features[20] = 0.98;                     // TEMP_STD
  raw_features[21] = rInt_mOhm / 1000.0;       // DC_IR converted to ohms
  raw_features[22] = powerW * (1.0 / 3600.0);  // ENERGY_WH approximation

  // Scale features for Ridge Regression (SoH)
  double scaled_features[23];
  for (int i = 0; i < 23; i++) {
    scaled_features[i] = (raw_features[i] - FEATURE_MEANS[i]) / FEATURE_SCALES[i];
  }

  // Execute C functions generated from your models
  predictedSoH = score(scaled_features); // Ridge regression for SoH
  // Note: if m2cgen generated 'score' for both headers, check rul_model.h to see if it's also score() or score_rul()
  predictedRUL = score(raw_features);    // Random Forest for RUL
}


// ============================================================
// Main Loop
// ============================================================
void loop() {
  unsigned long now = millis();

  // Check the actual critical cutoff continuously.
  // The shorter OLED timer may already be at 0; relay cutoff occurs
  // only when the longer ACTUAL timer expires.
  if (criticalTimerActive && criticalIsolationExpired()) {
    criticalRelayCutoff = true;
  }

  // Update LEDs and buzzer continuously so alarms/blinking are
  // smooth and independent of the 1-second sensor-read interval.
  updateStatusLEDs();
  updateBuzzer();

  // Switch OLED page every 10 seconds
  if (now - lastPageSwapTime >= PAGE_INTERVAL) {
    lastPageSwapTime = now;
    showStatusPage = !showStatusPage;
  }

  // Sensor update every 1 second
  if (now - lastSensorReadTime >= SENSOR_INTERVAL) {
    lastSensorReadTime = now;

// --------------------------------------------------------
    // 4. DERIVED ML FEATURES & INFERENCE
    // --------------------------------------------------------
    updateTimeFeatures();
    updateInternalResistance();
    
    // --> RUN THE ML MODELS LIVE <--
    runMachineLearningInference();
    // --------------------------------------------------------
    // 1. READ ADS1115 VOLTAGES
    // --------------------------------------------------------
    // A0 = Node 1 / Cell 1 positive
    // A1 = Node 2 / Cell 1 + Cell 2
    // A2 = Node 3 / full 3S pack
    vNode1 = readNodeVoltage(0, DIVIDER_RATIO_1);
    vNode2 = readNodeVoltage(1, DIVIDER_RATIO_2);
    vNode3 = readNodeVoltage(2, DIVIDER_RATIO_3);

    // Differential cell voltages
    vCell1 = vNode1;
    vCell2 = vNode2 - vNode1;
    vCell3 = vNode3 - vNode2;

    if (vCell1 < 0.0) vCell1 = 0.0;
    if (vCell2 < 0.0) vCell2 = 0.0;
    if (vCell3 < 0.0) vCell3 = 0.0;

    packVoltage = vNode3;

    minCell = min(vCell1, min(vCell2, vCell3));
    maxCell = max(vCell1, max(vCell2, vCell3));
    avgCell = (vCell1 + vCell2 + vCell3) / 3.0;
    cellImbalance = maxCell - minCell;

    // --------------------------------------------------------
    // 2. INA219 - CURRENT ONLY
    // --------------------------------------------------------
    float measuredCurrentA = ina219.getCurrent_mA() / 1000.0;

    // Magnitude is used for protection/ML feature.
    // Direction is not needed for the current prototype.
    currentA = fabs(measuredCurrentA);

    // Power is calculated from the independently measured pack
    // voltage, not INA219 bus voltage.
    powerW = packVoltage * currentA;

    // --------------------------------------------------------
    // 3. TEMPERATURES
    // --------------------------------------------------------
    tempSensor.requestTemperatures();

    t1 = tempSensor.getTempCByIndex(0);
    t2 = tempSensor.getTempCByIndex(1);
    t3 = tempSensor.getTempCByIndex(2);

    maxTemp = max(t1, max(t2, t3));
    avgTemp = (t1 + t2 + t3) / 3.0;

    float minTemp = min(t1, min(t2, t3));
    tempDifference = maxTemp - minTemp;

    // --------------------------------------------------------
    // 4. DERIVED ML FEATURES & INFERENCE
    // --------------------------------------------------------
    updateTimeFeatures();
    updateInternalResistance();

	// --> RUN THE ML MODELS LIVE <--
	runMachineLearningInference();

    // --------------------------------------------------------
    // 5. STATE EVALUATION
    // --------------------------------------------------------
    currentState = evaluateState();

    // --------------------------------------------------------
    // 5A. LOAD CURRENT ZERO AFTER CRITICAL CUTOFF
    // --------------------------------------------------------
    // The verified hardware test showed:
    //   CRITICAL -> COM-NO OPEN
    //   Load voltage -> ~0 V
    //   NO -> P- -> ~0 V
    // Therefore there is no load current after relay cutoff.
    // The INA219 is upstream of the relay, so its residual/stale
    // current register value must not be shown as load current.
    if (currentState == STATE_CRITICAL) {
      // Before actual cutoff, show real current/power. After relay opens,
      // show the verified load state as zero.
      if (criticalRelayCutoff || criticalIsolationExpired()) {
        currentA = 0.0f;
        powerW = 0.0f;
      } else {
        if (fabs(currentA) < 0.05f) currentA = 0.0f;
        powerW = packVoltage * currentA;
      }
    } else {
      if (fabs(currentA) < 0.05f) currentA = 0.0f;
      powerW = packVoltage * currentA;
    }

    // --------------------------------------------------------
    // 6. WARNING TIMER
    // --------------------------------------------------------
    updateCriticalTimer(currentState);

    // Final output interlock after actual critical cutoff.
    if (criticalRelayCutoff) {
      setRelay(false);
      digitalWrite(GREEN_LED_PIN, LOW);
      digitalWrite(YELLOW_LED_PIN, LOW);
      digitalWrite(RED_LED_PIN, LOW);
      stopBuzzerTone();
      buzzerState = false;
      currentA = 0.0f;
      powerW = 0.0f;
    }

    // --------------------------------------------------------
    // 7. SERIAL OUTPUT
    // --------------------------------------------------------
    printSerial();

    // --------------------------------------------------------
    // 8. OLED OUTPUT
    // --------------------------------------------------------
    if (currentState == STATE_CRITICAL) {
      displayCritical();
    } else if (currentState == STATE_WARNING) {
      if (showStatusPage) {
        displayStatusPage();
      } else {
        displayWarning();
      }
    } else {
      if (showStatusPage) {
        displayStatusPage();
      } else {
        displayNormal();
      }
    }
  }
}
