#include <Wire.h>
#include <Adafruit_GFX.h>
#include <Adafruit_SSD1306.h>
#include <Adafruit_ADS1X15.h>
#include <Adafruit_INA219.h>
#include <OneWire.h>
#include <DallasTemperature.h>
#include <math.h>

// Include ML model headers generated by m2cgen
#include "models/model_weights_v2.h"
#include "models/rul_model_v2.h"

// ============================================================
// BATTERY GUARDIAN - 3S Li-ion Monitoring + ML-Ready Features
// ============================================================

// -------------------- Hardware Pin Definitions --------------------
#define I2C_SDA      21
#define I2C_SCL      22
#define ONE_WIRE_BUS 4

// -------------------- Status LEDs --------------------
#define GREEN_LED_PIN  18
#define YELLOW_LED_PIN 19
#define RED_LED_PIN    25

// Relay control
#define RELAY_PIN      27
#define BUZZER_PIN     26
const bool RELAY_ACTIVE_LOW = false;

// Blink timing
const unsigned long WARNING_RED_BLINK_MS  = 500;
const unsigned long CRITICAL_RED_BLINK_MS = 150;

// Buzzer pattern
const unsigned long WARNING_BUZZ_ON_MS  = 250;
const unsigned long WARNING_BUZZ_OFF_MS = 750;
const unsigned long CRITICAL_BUZZ_ON_MS  = 120;
const unsigned long CRITICAL_BUZZ_OFF_MS = 120;

// -------------------- OLED --------------------
#define SCREEN_WIDTH  128
#define SCREEN_HEIGHT 64
#define OLED_RESET    -1

Adafruit_SSD1306 display(SCREEN_WIDTH, SCREEN_HEIGHT, &Wire, OLED_RESET);

// -------------------- Sensors --------------------
Adafruit_ADS1115 ads;
Adafruit_INA219  ina219;
OneWire oneWire(ONE_WIRE_BUS);
DallasTemperature tempSensor(&oneWire);

// -------------------- I2C Addresses --------------------
#define OLED_ADDRESS 0x3C
#define ADS_ADDRESS  0x48
#define INA_ADDRESS  0x40

// ============================================================
// VOLTAGE DIVIDER CALIBRATION
// ============================================================
const float DIVIDER_RATIO_1 = 4.0309;
const float DIVIDER_RATIO_2 = 4.0304;
const float DIVIDER_RATIO_3 = 4.0308;

// -------------------- Safety Thresholds --------------------
const float CELL_NORMAL_MIN = 3.30;
const float CELL_NORMAL_MAX = 4.15;
const float CELL_WARN_LOW   = 3.00;
const float CELL_WARN_HIGH  = 4.16;
const float CELL_CRIT_MIN   = 3.00;
const float CELL_CRIT_MAX   = 4.25;

const float IMBALANCE_CRIT  = 0.10;   // 100 mV

const float PACK_NORMAL_MIN = 9.90;
const float PACK_NORMAL_MAX = 12.45;
const float PACK_WARN_LOW   = 9.00;
const float PACK_WARN_HIGH  = 12.46;
const float PACK_CRIT_MIN   = 9.00;
const float PACK_CRIT_MAX   = 12.75;

const float CURRENT_NORMAL_MAX = 2.00;
const float CURRENT_WARN_MAX   = 3.499;
const float CURRENT_CRIT_MAX   = 3.50;

const float TEMP_NORMAL_MAX = 40.0;
const float TEMP_WARN_MAX   = 47.9;
const float TEMP_CRIT_MAX   = 48.0;

// -------------------- Timing --------------------
const unsigned long SENSOR_INTERVAL = 1000;
const unsigned long PAGE_INTERVAL   = 10000;

unsigned long lastSensorReadTime = 0;
unsigned long lastPageSwapTime   = 0;
bool showStatusPage = false;

// -------------------- Critical Safety Timer --------------------
bool criticalTimerActive = false;
bool criticalRelayCutoff = false;
unsigned long criticalStartMillis = 0;
unsigned long criticalActualDurationMillis = 30000UL;
unsigned long criticalDisplayedDurationMillis = 15000UL;
int criticalSeverity = 1;

bool redLedState = false;
unsigned long lastRedBlinkMillis = 0;

bool buzzerState = false;
unsigned long lastBuzzerMillis = 0;

// -------------------- ML Inference Variables --------------------
float predictedSoH = 100.0;
float predictedRUL = 800.0;

// -------------------- Cycle Tracking Variables (Option B) --------------------
bool cycleActive = false;
unsigned long cycleStartMillis = 0;
float cycleStartVoltage = 0.0;
float cumulativeWattHours = 0.0;
unsigned long lastEnergyCalcMillis = 0;

// Scaler means and scales extracted from training dataset
const float FEATURE_MEANS[23] = {
  5389.3094, 11.7988, 10.1638, 3.5721, 3.7466, 3.6604, 1.6350, -0.0010, 
  0.0883, 0.0010, 1.9776, 0.9882, 2.9481, 23.6003, 31.6213, 23.1018, 
  33.0797, 27.6108, 8.0858, 0.0029, 0.4020, 0.1239, 25.0106
};

const float FEATURE_SCALES[23] = {
  3928.6119, 0.4618, 0.9064, 0.2689, 0.2145, 0.2009, 0.7855, 0.0024, 
  0.1417, 0.7972, 1.1347, 0.8670, 1.2571, 7.7633, 12.6427, 7.7637, 
  12.5818, 9.3129, 9.8166, 0.0051, 0.6038, 0.1246, 17.7338
};

// -------------------- Sensor Variables --------------------
float vNode1 = 0.0;
float vNode2 = 0.0;
float vNode3 = 0.0;

float vCell1 = 0.0;
float vCell2 = 0.0;
float vCell3 = 0.0;
float packVoltage = 0.0;

float currentA = 0.0;
float powerW = 0.0;

float t1 = 0.0;
float t2 = 0.0;
float t3 = 0.0;

float minCell = 0.0;
float maxCell = 0.0;
float avgCell = 0.0;
float cellImbalance = 0.0;

float maxTemp = 0.0;
float avgTemp = 0.0;
float tempDifference = 0.0;

// -------------------- ML-Ready Time Features --------------------
float previousPackVoltage = 0.0;
float previousMaxTemp = 0.0;
float previousCurrentA = 0.0;

float dVdt = 0.0;
float dTdt = 0.0;
float dIdt = 0.0;

unsigned long previousFeatureTime = 0;

// -------------------- Simple Internal Resistance Estimate --------------------
float vOpenCircuit = 0.0;
float rInt_mOhm = 0.0;

// -------------------- Status Reason --------------------
String warningReason = "";
String criticalReason = "";

// -------------------- System State --------------------
enum SystemState {
  STATE_NORMAL,
  STATE_WARNING,
  STATE_CRITICAL
};

SystemState currentState = STATE_NORMAL;
SystemState previousState = STATE_NORMAL;
bool criticalLatched = false;

// ============================================================
// Read voltage using ADS1115 and calibrated divider
// ============================================================
float readNodeVoltage(uint8_t channel, float dividerRatio) {
  const uint8_t SAMPLES = 8;
  long rawSum = 0;

  for (uint8_t i = 0; i < SAMPLES; i++) {
    rawSum += ads.readADC_SingleEnded(channel);
    delayMicroseconds(200);
  }

  int16_t rawAverage = (int16_t)(rawSum / SAMPLES);
  float adcVoltage = ads.computeVolts(rawAverage);

  if (adcVoltage < 0.0f) {
    adcVoltage = 0.0f;
  }

  return adcVoltage * dividerRatio;
}

// ============================================================
// CRITICAL TIMING
// ============================================================
int getCriticalSeverity() {
  int severity = 1;

  if (maxTemp >= 55.0) severity = max(severity, 3);
  else if (maxTemp >= 51.0) severity = max(severity, 2);

  if (minCell < 2.80 || maxCell > 4.35) severity = max(severity, 3);
  else if (minCell < 2.90 || maxCell > 4.30) severity = max(severity, 2);

  if (cellImbalance >= 0.20) severity = max(severity, 3);
  else if (cellImbalance >= 0.15) severity = max(severity, 2);

  if (currentA >= 5.0) severity = max(severity, 3);
  else if (currentA >= 4.0) severity = max(severity, 2);

  if (packVoltage < 8.70 || packVoltage > 13.00) severity = max(severity, 3);
  else if (packVoltage < 8.90 || packVoltage > 12.90) severity = max(severity, 2);

  return severity;
}

void calculateCriticalTimes() {
  criticalSeverity = getCriticalSeverity();

  if (criticalSeverity >= 3) {
    criticalActualDurationMillis = 30000UL;
    criticalDisplayedDurationMillis = 15000UL;
  } else if (criticalSeverity == 2) {
    criticalActualDurationMillis = 60000UL;
    criticalDisplayedDurationMillis = 30000UL;
  } else {
    criticalActualDurationMillis = 90000UL;
    criticalDisplayedDurationMillis = 45000UL;
  }
}

int getCriticalDisplayedSecondsRemaining() {
  if (!criticalTimerActive) return 0;
  unsigned long elapsed = millis() - criticalStartMillis;
  if (elapsed >= criticalDisplayedDurationMillis) return 0;
  return (int)((criticalDisplayedDurationMillis - elapsed + 999UL) / 1000UL);
}

int getCriticalActualSecondsRemaining() {
  if (!criticalTimerActive) return 0;
  unsigned long elapsed = millis() - criticalStartMillis;
  if (elapsed >= criticalActualDurationMillis) return 0;
  return (int)((criticalActualDurationMillis - elapsed + 999UL) / 1000UL);
}

bool criticalIsolationExpired() {
  return criticalTimerActive &&
         ((millis() - criticalStartMillis) >= criticalActualDurationMillis);
}

void startCriticalTimer() {
  calculateCriticalTimes();
  criticalStartMillis = millis();
  criticalTimerActive = true;
  criticalRelayCutoff = false;
}

// ============================================================
// Evaluate State
// ============================================================
SystemState evaluateState() {
  warningReason = "";

  if (criticalLatched) {
    return STATE_CRITICAL;
  }

  criticalReason = "";

  if (maxTemp >= TEMP_CRIT_MAX) {
    criticalReason = "OVER TEMP";
    criticalLatched = true;
    return STATE_CRITICAL;
  }
  if (minCell < CELL_CRIT_MIN) {
    criticalReason = "CELL UNDER V";
    criticalLatched = true;
    return STATE_CRITICAL;
  }
  if (maxCell > CELL_CRIT_MAX) {
    criticalReason = "CELL OVER V";
    criticalLatched = true;
    return STATE_CRITICAL;
  }
  if (cellImbalance > IMBALANCE_CRIT) {
    criticalReason = "CELL IMBALANCE";
    criticalLatched = true;
    return STATE_CRITICAL;
  }
  if (currentA >= CURRENT_CRIT_MAX) {
    criticalReason = "OVER CURRENT";
    criticalLatched = true;
    return STATE_CRITICAL;
  }
  if (packVoltage < PACK_CRIT_MIN) {
    criticalReason = "PACK UNDER V";
    criticalLatched = true;
    return STATE_CRITICAL;
  }
  if (packVoltage > PACK_CRIT_MAX) {
    criticalReason = "PACK OVER V";
    criticalLatched = true;
    return STATE_CRITICAL;
  }

  if (maxTemp >= TEMP_NORMAL_MAX && maxTemp < TEMP_CRIT_MAX) {
    warningReason = "TEMP RISING";
    return STATE_WARNING;
  }
  if (minCell < CELL_NORMAL_MIN && minCell >= CELL_CRIT_MIN) {
    warningReason = "LOW CELL V";
    return STATE_WARNING;
  }
  if (maxCell > CELL_NORMAL_MAX && maxCell <= CELL_CRIT_MAX) {
    warningReason = "HIGH CELL V";
    return STATE_WARNING;
  }
  if (cellImbalance > IMBALANCE_CRIT) {
    warningReason = "CELL IMBALANCE";
    return STATE_WARNING;
  }
  if (currentA >= CURRENT_NORMAL_MAX && currentA < CURRENT_CRIT_MAX) {
    warningReason = "HIGH CURRENT";
    return STATE_WARNING;
  }
  if ((packVoltage >= PACK_WARN_LOW && packVoltage < PACK_NORMAL_MIN) ||
      (packVoltage > PACK_NORMAL_MAX && packVoltage <= PACK_WARN_HIGH)) {
    warningReason = "PACK VOLTAGE";
    return STATE_WARNING;
  }

  return STATE_NORMAL;
}

void updateCriticalTimer(SystemState newState) {
  if (newState != STATE_CRITICAL) {
    criticalTimerActive = false;
    criticalRelayCutoff = false;
    previousState = newState;
    return;
  }

  if (previousState != STATE_CRITICAL && !criticalTimerActive) {
    startCriticalTimer();
  }

  if (criticalTimerActive && criticalIsolationExpired()) {
    criticalRelayCutoff = true;
  }

  previousState = newState;
}

// ============================================================
// Update ML time features
// ============================================================
void updateTimeFeatures() {
  unsigned long now = millis();

  if (previousFeatureTime == 0) {
    previousFeatureTime = now;
    previousPackVoltage = packVoltage;
    previousMaxTemp = maxTemp;
    previousCurrentA = currentA;
    dVdt = 0.0;
    dTdt = 0.0;
    dIdt = 0.0;
    return;
  }

  float dt = (now - previousFeatureTime) / 1000.0;

  if (dt > 0.0) {
    dVdt = (packVoltage - previousPackVoltage) / dt;
    dTdt = (maxTemp - previousMaxTemp) / dt;
    dIdt = (currentA - previousCurrentA) / dt;
  }

  previousFeatureTime = now;
  previousPackVoltage = packVoltage;
  previousMaxTemp = maxTemp;
  previousCurrentA = currentA;
}

void updateInternalResistance() {
  if (currentA < 0.03) {
    vOpenCircuit = packVoltage;
    rInt_mOhm = 0.0;
    return;
  }

  float vDrop = vOpenCircuit - packVoltage;

  if (currentA > 0.10 && vDrop > 0.01) {
    rInt_mOhm = (vDrop / currentA) * 1000.0;
  } else {
    rInt_mOhm = 0.0;
  }
}

// ============================================================
// Machine Learning Inference Routine (Option B)
// ============================================================
void runMachineLearningInference() {
  if (!cycleActive) return;

  unsigned long currentMillis = millis();
  float durationSeconds = (currentMillis - cycleStartMillis) / 1000.0f;

  double raw_features[23];
  raw_features[0] = durationSeconds;                  // DURATION_S
  raw_features[1] = cycleStartVoltage;                // V_START
  raw_features[2] = packVoltage;                      // V_END
  raw_features[3] = minCell;                          // V_MIN
  raw_features[4] = maxCell;                          // V_MAX
  raw_features[5] = avgCell;                          // V_MEAN
  raw_features[6] = (cycleStartVoltage - packVoltage); // V_DROP
  raw_features[7] = dVdt;                             // VOLTAGE_SLOPE
  raw_features[8] = 1.0;                              // V_STD
  raw_features[9] = 0.0;                              // V_SKEW
  raw_features[10] = currentA;                        // I_MEAN
  raw_features[11] = currentA;                        // I_MIN
  raw_features[12] = currentA;                        // I_MAX
  raw_features[13] = t1;                              // T_START
  raw_features[14] = maxTemp;                         // T_END
  raw_features[15] = t1;                              // T_MIN
  raw_features[16] = maxTemp;                         // T_MAX
  raw_features[17] = avgTemp;                         // T_MEAN
  raw_features[18] = (maxTemp - t1);                  // TEMP_RISE
  raw_features[19] = dTdt;                            // TEMP_RISE_RATE
  raw_features[20] = 0.98;                            // TEMP_STD
  raw_features[21] = rInt_mOhm / 1000.0;              // DC_IR converted to ohms
  raw_features[22] = cumulativeWattHours;             // ENERGY_WH

  double scaled_features[23];
  for (int i = 0; i < 23; i++) {
    scaled_features[i] = (raw_features[i] - FEATURE_MEANS[i]) / FEATURE_SCALES[i];
  }

  // Execute uniquely named C functions generated by m2cgen
  predictedSoH = score_soh(scaled_features); 
  
  if (predictedSoH > 100.0f) predictedSoH = 100.0f;
  if (predictedSoH < 0.0f) predictedSoH = 0.0f;

  predictedRUL = score_rul(raw_features);    
  if (predictedRUL < 0.0f) predictedRUL = 0.0f;
}

// ============================================================
// Serial output
// ============================================================
void printSerial() {
  Serial.println();
  Serial.println(F("===================================================="));
  Serial.println(F("                    BATTERY GUARDIAN"));
  Serial.println(F("===================================================="));

  Serial.println(F("------ CELL VOLTAGES ------"));
  Serial.printf("Cell 1: %.3f V\n", vCell1);
  Serial.printf("Cell 2: %.3f V\n", vCell2);
  Serial.printf("Cell 3: %.3f V\n", vCell3);
  Serial.printf("Pack  : %.3f V\n", packVoltage);
  Serial.printf("Imbalance: %.1f mV\n", cellImbalance * 1000.0);

  Serial.println(F("------ INA219 ------"));
  Serial.printf("Current: %.3f A\n", currentA);
  Serial.printf("Power  : %.3f W\n", powerW);

  Serial.println(F("------ TEMPERATURE ------"));
  Serial.printf("T1: %.2f C\n", t1);
  Serial.printf("T2: %.2f C\n", t2);
  Serial.printf("T3: %.2f C\n", t3);
  Serial.printf("Max Temp: %.2f C\n", maxTemp);
  Serial.printf("Temp Difference: %.2f C\n", tempDifference);

  Serial.println(F("------ ML FEATURES ------"));
  Serial.printf("Vmin: %.3f V\n", minCell);
  Serial.printf("Vmax: %.3f V\n", maxCell);
  Serial.printf("Vavg: %.3f V\n", avgCell);
  Serial.printf("Tavg: %.2f C\n", avgTemp);
  Serial.printf("dV/dt: %.5f V/s\n", dVdt);
  Serial.printf("dT/dt: %.5f C/s\n", dTdt);
  Serial.printf("dI/dt: %.5f A/s\n", dIdt);
  Serial.printf("Rint: %.2f mOhm\n", rInt_mOhm);

  Serial.println(F("------ ML OUTPUTS ------"));
  Serial.printf("SoH: %.2f %%\n", predictedSoH);
  Serial.printf("RUL: %.0f cycles\n", predictedRUL);

  if (currentState == STATE_CRITICAL) {
    Serial.printf("STATE: CRITICAL - %s\n", criticalReason.c_str());
    Serial.printf("CRITICAL SEVERITY: %d\n", criticalSeverity);
    if (criticalRelayCutoff || criticalIsolationExpired()) {
      Serial.println(F("RELAY: OFF - LOAD ISOLATED"));
      Serial.println(F("Current: 0.000 A | Power: 0.000 W"));
    } else {
      Serial.printf("OLED SAFE TIME REMAINING: %d s\n", getCriticalDisplayedSecondsRemaining());
      Serial.printf("ACTUAL RELAY CUTOFF REMAINING: %d s\n", getCriticalActualSecondsRemaining());
      Serial.println(F("RELAY: ON DURING CRITICAL SAFETY COUNTDOWN"));
    }
  } else if (currentState == STATE_WARNING) {
    Serial.printf("STATE: WARNING - %s\n", warningReason.c_str());
    Serial.println(F("RELAY: ON - NO CRITICAL TIMER"));
  } else {
    Serial.println(F("STATE: NORMAL"));
  }

  Serial.println(F("===================================================="));
}

// ============================================================
// OLED NORMAL
// ============================================================
void displayNormal() {
  display.clearDisplay();
  display.setTextSize(1);
  display.setCursor(18, 0);
  display.print(F("BATTERY GUARDIAN"));

  display.setCursor(0, 8);
  display.printf("C1:%.2fV C2:%.2fV", vCell1, vCell2);

  display.setCursor(0, 16);
  display.printf("C3:%.2fV Pk:%.2fV", vCell3, packVoltage);

  display.setCursor(0, 24);
  display.printf("I:%.2fA P:%.2fW", currentA, powerW);

  display.setCursor(0, 32);
  display.printf("SoH:%.1f%% RUL:%d", predictedSoH, (int)predictedRUL);

  display.setCursor(0, 40);
  display.printf("T:%.1fC dV:%.0fmV", maxTemp, cellImbalance * 1000.0);

  display.setCursor(0, 48);
  display.printf("T:%.1fC IR:%.1fmO", maxTemp, rInt_mOhm);

  display.setCursor(0, 56);
  display.print(F("STATE: NORMAL"));

  display.display();
}

// ============================================================
// OLED WARNING
// ============================================================
void displayWarning() {
  display.clearDisplay();
  display.setTextSize(1);
  display.setCursor(25, 0);
  display.print(F("!! WARNING !!"));

  display.setCursor(0, 14);
  display.print(warningReason);

  display.setTextSize(2);
  display.setCursor(15, 28);
  display.print(F("RELAY ON"));

  display.setTextSize(1);
  display.setCursor(0, 50);
  display.print(F("MOVE TO SAFE AREA"));

  display.setCursor(0, 60);
  display.print(F("Battery still powered"));

  display.display();
}

// ============================================================
// OLED CRITICAL
// ============================================================
void displayCritical() {
  display.clearDisplay();

  display.setTextSize(1);
  display.setCursor(26, 0);
  display.print(F("!! CRITICAL !!"));

  display.setTextSize(2);
  display.setCursor(13, 15);
  display.print(F("DANGER"));

  display.setTextSize(1);
  display.setCursor(0, 36);
  display.print(criticalReason);

  if (criticalRelayCutoff || criticalIsolationExpired()) {
    display.setCursor(0, 46);
    display.print(F("POWER OFF  I:0.00A"));
    display.setCursor(0, 56);
    display.print(F("RELAY OFF  P:0.00W"));
  } else {
    display.setCursor(0, 46);
    display.printf("SAFE TIME: %02ds", getCriticalDisplayedSecondsRemaining());
    display.setCursor(0, 56);
    display.printf("RELAY ON  I:%.2fA", currentA);
  }

  display.display();
}

// ============================================================
// OLED STATUS PAGE
// ============================================================
void displayStatusPage() {
  display.clearDisplay();
  display.setTextSize(1);
  display.setCursor(16, 0);
  display.print(F("-- SYSTEM STATUS --"));

  if (currentState == STATE_CRITICAL) {
    display.setTextSize(2);
    display.setCursor(12, 16);
    display.print(F("CRITICAL"));

    display.setTextSize(1);
    display.setCursor(5, 37);
    display.print(criticalReason);

    display.setCursor(0, 48);
    if (criticalRelayCutoff || criticalIsolationExpired()) {
      display.print(F("POWER OFF I:0.00A"));
    } else {
      display.printf("SAFE:%02ds ACT:%02ds", getCriticalDisplayedSecondsRemaining(), getCriticalActualSecondsRemaining());
    }

    display.setCursor(0, 59);
    display.print((criticalRelayCutoff || criticalIsolationExpired()) ? F("RELAY OFF P:0.00W") : F("RELAY ON"));

  } else if (currentState == STATE_WARNING) {
    display.setTextSize(2);
    display.setCursor(15, 15);
    display.print(F("WARNING"));

    display.setTextSize(1);
    display.setCursor(0, 37);
    display.print(warningReason);

    display.setCursor(0, 51);
    display.print(F("RELAY ON - POWER ON"));

  } else {
    display.setTextSize(2);
    display.setCursor(28, 16);
    display.print(F("NORMAL"));

    display.setTextSize(1);
    display.setCursor(22, 37);
    display.print(F("All Systems OK"));

    display.setCursor(0, 52);
    display.printf("Pack:%.2fV T:%.1fC", packVoltage, maxTemp);
  }

  display.display();
}

// ============================================================
// RELAY CONTROL
// ============================================================
void setRelay(bool on) {
  bool outputLevel;
  if (RELAY_ACTIVE_LOW) {
    outputLevel = on ? LOW : HIGH;
  } else {
    outputLevel = on ? HIGH : LOW;
  }
  digitalWrite(RELAY_PIN, outputLevel);
}

// ============================================================
// BUZZER CONTROL
// ============================================================
void startBuzzerTone(unsigned int frequency) {
  (void)frequency;
  digitalWrite(BUZZER_PIN, HIGH);
}

void stopBuzzerTone() {
  digitalWrite(BUZZER_PIN, LOW);
}

void updateBuzzer() {
  unsigned long now = millis();

  if (criticalRelayCutoff) {
    stopBuzzerTone();
    buzzerState = false;
    return;
  }

  if (currentState == STATE_NORMAL) {
    stopBuzzerTone();
    buzzerState = false;
    lastBuzzerMillis = now;
  }
  else if (currentState == STATE_WARNING) {
    unsigned long interval = buzzerState ? WARNING_BUZZ_ON_MS : WARNING_BUZZ_OFF_MS;
    if (now - lastBuzzerMillis >= interval) {
      lastBuzzerMillis = now;
      buzzerState = !buzzerState;
      if (buzzerState) startBuzzerTone(1);
      else stopBuzzerTone();
    }
  }
  else {  // STATE_CRITICAL
    unsigned long interval = buzzerState ? CRITICAL_BUZZ_ON_MS : CRITICAL_BUZZ_OFF_MS;
    if (now - lastBuzzerMillis >= interval) {
      lastBuzzerMillis = now;
      buzzerState = !buzzerState;
      if (buzzerState) startBuzzerTone(1);
      else stopBuzzerTone();
    }
  }
}

// ============================================================
// STATUS LED CONTROL
// ============================================================
void updateStatusLEDs() {
  unsigned long now = millis();

  if (currentState == STATE_NORMAL) {
    digitalWrite(GREEN_LED_PIN, HIGH);
    digitalWrite(YELLOW_LED_PIN, LOW);
    digitalWrite(RED_LED_PIN, LOW);
    setRelay(true);
    redLedState = false;
    lastRedBlinkMillis = now;
  }
  else if (currentState == STATE_WARNING) {
    digitalWrite(GREEN_LED_PIN, LOW);
    digitalWrite(YELLOW_LED_PIN, HIGH);
    setRelay(true);
    if (now - lastRedBlinkMillis >= WARNING_RED_BLINK_MS) {
      lastRedBlinkMillis = now;
      redLedState = !redLedState;
      digitalWrite(RED_LED_PIN, redLedState ? HIGH : LOW);
    }
  }
  else {
    if (criticalRelayCutoff) {
      setRelay(false);
      digitalWrite(GREEN_LED_PIN, LOW);
      digitalWrite(YELLOW_LED_PIN, LOW);
      digitalWrite(RED_LED_PIN, LOW);
      stopBuzzerTone();
      buzzerState = false;
      return;
    }

    digitalWrite(GREEN_LED_PIN, LOW);
    digitalWrite(YELLOW_LED_PIN, LOW);

    if (criticalTimerActive && !criticalIsolationExpired()) {
      setRelay(true);
    } else {
      criticalRelayCutoff = true;
      setRelay(false);
      digitalWrite(GREEN_LED_PIN, LOW);
      digitalWrite(YELLOW_LED_PIN, LOW);
      digitalWrite(RED_LED_PIN, LOW);
      stopBuzzerTone();
      buzzerState = false;
      return;
    }

    if (now - lastRedBlinkMillis >= CRITICAL_RED_BLINK_MS) {
      lastRedBlinkMillis = now;
      redLedState = !redLedState;
      digitalWrite(RED_LED_PIN, redLedState ? HIGH : LOW);
    }
  }
}

// ============================================================
// Setup
// ============================================================
void setup() {
  pinMode(BUZZER_PIN, OUTPUT);
  digitalWrite(BUZZER_PIN, LOW);

  Serial.begin(115200);
  delay(1000);

  Serial.println();
  Serial.println(F("=============================================="));
  Serial.println(F("        BATTERY GUARDIAN STARTING"));
  Serial.println(F("=============================================="));

  pinMode(GREEN_LED_PIN, OUTPUT);
  pinMode(YELLOW_LED_PIN, OUTPUT);
  pinMode(RED_LED_PIN, OUTPUT);
  pinMode(RELAY_PIN, OUTPUT);

  digitalWrite(GREEN_LED_PIN, LOW);
  digitalWrite(YELLOW_LED_PIN, LOW);
  digitalWrite(RED_LED_PIN, LOW);
  stopBuzzerTone();
  setRelay(false);
  criticalLatched = false;
  criticalTimerActive = false;
  criticalRelayCutoff = false;

  Wire.begin(I2C_SDA, I2C_SCL);

  if (!display.begin(SSD1306_SWITCHCAPVCC, OLED_ADDRESS)) {
    Serial.println(F("ERROR: OLED initialization failed."));
    while (true) delay(100);
  }
  display.clearDisplay();
  display.setTextColor(SSD1306_WHITE);
  display.setTextSize(1);
  display.setCursor(16, 20);
  display.println(F("BATTERY GUARDIAN"));
  display.setCursor(12, 35);
  display.println(F("Initializing..."));
  display.display();

  if (!ads.begin(ADS_ADDRESS)) {
    Serial.println(F("ERROR: ADS1115 not detected."));
    while (true) delay(100);
  }
  ads.setGain(GAIN_ONE);
  Serial.println(F("SUCCESS: ADS1115 detected at 0x48."));

  if (!ina219.begin()) {
    Serial.println(F("ERROR: INA219 not detected."));
    while (true) delay(100);
  }
  ina219.setCalibration_32V_2A();
  Serial.println(F("SUCCESS: INA219 detected at 0x40."));

  tempSensor.begin();
  int sensorCount = tempSensor.getDeviceCount();
  Serial.printf("DS18B20 sensors found: %d\n", sensorCount);

  delay(1500);
}

// ============================================================
// Main Loop
// ============================================================
void loop() {
  unsigned long now = millis();

  if (criticalTimerActive && criticalIsolationExpired()) {
    criticalRelayCutoff = true;
  }

  updateStatusLEDs();
  updateBuzzer();

  if (now - lastPageSwapTime >= PAGE_INTERVAL) {
    lastPageSwapTime = now;
    showStatusPage = !showStatusPage;
  }

  // Sensor update every 1 second
  if (now - lastSensorReadTime >= SENSOR_INTERVAL) {
    lastSensorReadTime = now;

    // 1. Read ADS1115 Voltages
    vNode1 = readNodeVoltage(0, DIVIDER_RATIO_1);
    vNode2 = readNodeVoltage(1, DIVIDER_RATIO_2);
    vNode3 = readNodeVoltage(2, DIVIDER_RATIO_3);

    vCell1 = vNode1;
    vCell2 = vNode2 - vNode1;
    vCell3 = vNode3 - vNode2;

    if (vCell1 < 0.0) vCell1 = 0.0;
    if (vCell2 < 0.0) vCell2 = 0.0;
    if (vCell3 < 0.0) vCell3 = 0.0;

    packVoltage = vNode3;

    minCell = min(vCell1, min(vCell2, vCell3));
    maxCell = max(vCell1, max(vCell2, vCell3));
    avgCell = (vCell1 + vCell2 + vCell3) / 3.0;
    cellImbalance = maxCell - minCell;

    // 2. INA219 Current
    float measuredCurrentA = ina219.getCurrent_mA() / 1000.0;
    currentA = fabs(measuredCurrentA);
    powerW = packVoltage * currentA;

    // 3. Temperatures
    tempSensor.requestTemperatures();
    t1 = tempSensor.getTempCByIndex(0);
    t2 = tempSensor.getTempCByIndex(1);
    t3 = tempSensor.getTempCByIndex(2);

    maxTemp = max(t1, max(t2, t3));
    avgTemp = (t1 + t2 + t3) / 3.0;
    tempDifference = maxTemp - min(t1, min(t2, t3));

    // 4. Derived ML Features & Cycle Tracking
    updateTimeFeatures();
    updateInternalResistance();

    // Option B: Cycle tracking and energy integration (Relaxed for testing if packVoltage > 9.0V)
    if (!cycleActive && packVoltage > 9.0f) {
      cycleActive = true;
      cycleStartMillis = millis();
      cycleStartVoltage = packVoltage;
      cumulativeWattHours = 0.0f;
      lastEnergyCalcMillis = cycleStartMillis;
    }

    if (cycleActive) {
      unsigned long nowMs = millis();
      float hoursElapsed = (nowMs - lastEnergyCalcMillis) / 3600000.0f;
      cumulativeWattHours += powerW * hoursElapsed;
      lastEnergyCalcMillis = nowMs;

      // Run live model inference during the active cycle
      runMachineLearningInference();
    }

    if (packVoltage < 8.5f) {
      cycleActive = false;
    }

    // 5. State Evaluation & Safety Interlocks
    currentState = evaluateState();

    if (currentState == STATE_CRITICAL) {
      if (criticalRelayCutoff || criticalIsolationExpired()) {
        currentA = 0.0f;
        powerW = 0.0f;
      } else {
        if (fabs(currentA) < 0.05f) currentA = 0.0f;
        powerW = packVoltage * currentA;
      }
    } else {
      if (fabs(currentA) < 0.05f) currentA = 0.0f;
      powerW = packVoltage * currentA;
    }

    updateCriticalTimer(currentState);

    if (criticalRelayCutoff) {
      setRelay(false);
      digitalWrite(GREEN_LED_PIN, LOW);
      digitalWrite(YELLOW_LED_PIN, LOW);
      digitalWrite(RED_LED_PIN, LOW);
      stopBuzzerTone();
      buzzerState = false;
      currentA = 0.0f;
      powerW = 0.0f;
    }

    // 7. Serial & OLED Output
    printSerial();

    if (currentState == STATE_CRITICAL) {
      displayCritical();
    } else if (currentState == STATE_WARNING) {
      if (showStatusPage) displayStatusPage();
      else displayWarning();
    } else {
      if (showStatusPage) displayStatusPage();
      else displayNormal();
    }
  }
}
